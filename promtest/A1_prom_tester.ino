////////////////////////////////////////////////////////////////////
//
//        Apple-1 PROM TESTER for Arduino Nano & compatibles
//
//    by Claudio Parmigiani - P-LAB 2021 -  P-L4B@PROTONMAIL.COM
//
//   Autodetects and individually test MONITOR PROMs and ACI PROMs
//
//
////////////////////////////////////////////////////////////////////

////////////////////////////////////////////////////////////////////
// Woz Monitor Code
////////////////////////////////////////////////////////////////////
byte woz_bin[]  = {
  0xd8, 0x58, 0xa0, 0x7f, 0x8c, 0x12, 0xd0, 0xa9, 0xa7, 0x8d, 0x11, 0xd0,
  0x8d, 0x13, 0xd0, 0xc9, 0xdf, 0xf0, 0x13, 0xc9, 0x9b, 0xf0, 0x03, 0xc8,
  0x10, 0x0f, 0xa9, 0xdc, 0x20, 0xef, 0xff, 0xa9, 0x8d, 0x20, 0xef, 0xff,
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  0x00, 0xff, 0x00, 0x00
};

////////////////////////////////////////////////////////////////////
// Woz Apple Cassette Interface Code
////////////////////////////////////////////////////////////////////
byte aci_bin[] = {
  0xA9, 0xAA, 0x20, 0xEF, 0xFF, 0xA9, 0x8D, 0x20, 0xEF, 0xFF, 0xA0, 0xFF, 0xC8, 0xAD, 0x11, 0xD0,
  0x10, 0xFB, 0xAD, 0x10, 0xD0, 0x99, 0x00, 0x02, 0x20, 0xEF, 0xFF, 0xC9, 0x9B, 0xF0, 0xE1, 0xC9,
  0x8D, 0xD0, 0xE9, 0xA2, 0xFF, 0xA9, 0x00, 0x85, 0x24, 0x85, 0x25, 0x85, 0x26, 0x85, 0x27, 0xE8,
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  0x60, 0xA5, 0x26, 0xC5, 0x24, 0xA5, 0x27, 0xE5, 0x25, 0xE6, 0x26, 0xD0, 0x02, 0xE6, 0x27, 0x60
};

#define EVER (;;);
int REF, READ, i, MON, HI;
String DESC;

void setup() {         //                 --> VCC=PROM pin 16, GND=PROM pin 8, ~E1/P=PROM pin 13 to GND
  Serial.begin(115200);
  pinMode(LED_BUILTIN, OUTPUT);
  pinMode(12, OUTPUT);  //~CSelect        --> to PROM pin 14
  digitalWrite(12, HIGH);
  //data bits
  pinMode (A0, INPUT);  //data bit 0      --> to PROM pin 12
  pinMode (A1, INPUT);  //data bit 1      --> to PROM pin 11
  pinMode (A2, INPUT);  //data bit 2      --> to PROM pin 10
  pinMode (A3, INPUT);  //data bit 3      --> to PROM pin 9
  //address bits
  pinMode (2, OUTPUT);  //address bit 0   --> to PROM pin 5
  pinMode (3, OUTPUT);  //address bit 1   --> to PROM pin 6
  pinMode (4, OUTPUT);  //address bit 2   --> to PROM pin 7
  pinMode (5, OUTPUT);  //address bit 3   --> to PROM pin 4
  pinMode (6, OUTPUT);  //address bit 4   --> to PROM pin 3
  pinMode (7, OUTPUT);  //address bit 5   --> to PROM pin 2
  pinMode (8, OUTPUT);  //address bit 6   --> to PROM pin 1
  pinMode (9, OUTPUT);  //address bit 7   --> to PROM pin 15

  //autodetect which PROM will be tested
  digitalWrite(12, LOW); //select
  detectProm();
  Serial.print("Detected: ");
  Serial.println(DESC);
  if (DESC == "FAIL!") {
    error();
  }
  //test
  for ( i = 0; i <= 255; i++)
  {
    Serial.print("Address=");
    Serial.print(i, HEX);
    Serial.print(" Expected=");
    if (MON == 1) {
      REF = woz_bin[i];
    }
    else {
      REF = aci_bin[i];
    }
    if (HI == 1) {
      REF = REF / 16;
    }
    else {
      REF = REF & 15;
    }
    Serial.print(REF, HEX);
    readProm();
    Serial.print(" READ=");
    Serial.print(READ, HEX);
    if (REF == READ) {
      Serial.print("  --> PASS");
    }
    else {
      Serial.println("  *** FAIL ***");
      error();
    }
    Serial.println();
    //delay(10);
  }
  Serial.println();
  Serial.print(DESC);
  Serial.println(" TEST PASSED!");
}

void detectProm() {
  i = 0;
  readProm();
  switch (READ) {
    case 13:
      DESC = "MON A2"; HI = 1; MON = 1; break;  //D
    case 8:
      DESC = "MON A1"; HI = 0; MON = 1; break;  //8
    case 10:
      DESC = "ACI A3"; HI = 1; MON = 0; break;  //A
    case 9:
      DESC = "ACI A4"; HI = 0; MON = 0; break;  //9
    default: DESC = "FAIL!"; break; //none of the above: PROM failure!
  }
}

void readProm() {
  //set address lines
  for (int j = 0; j <= 7; j++) {
    int bitToCheck = round(pow(2, j));
    boolean addressLine = i & bitToCheck;
    digitalWrite((j + 2), addressLine);
  }
  //read data lines
  READ = digitalRead(A0)\
         +digitalRead(A1) * 2\
         +digitalRead(A2) * 4\
         +digitalRead(A3) * 8;
}

void loop() {
  //deselect
  digitalWrite(12, HIGH);
  //heartbeat blink if PROM is healthy
  digitalWrite(LED_BUILTIN, HIGH);
  delay(100);
  digitalWrite(LED_BUILTIN, LOW);
  delay(100);
  digitalWrite(LED_BUILTIN, HIGH);
  delay(100);
  digitalWrite(LED_BUILTIN, LOW);
  delay(1000);
}

void error() {
  //builtin LED permanently lit in case of error.
  digitalWrite(LED_BUILTIN, HIGH);
  //deselect
  digitalWrite(12, HIGH);
  for EVER
}
